## boards/arm/pocketboard/Kconfig.defconfig
```kconfig
# Copyright (c) 2021 The ZMK Contributors
# SPDX-License-Identifier: MIT

if BOARD_POCKETBOARD

config ZMK_KEYBOARD_NAME
	default "Pocketboard"

if USB

config USB_NRFX
    default y

config USB_DEVICE_STACK
	default y

endif # USB

config ZMK_BLE
	default y

config ZMK_USB
	default y

config I2C
	default y

config ZMK_MAX17048
	default y

endif # BOARD_POCKETBOARD
```

## boards/arm/pocketboard/Kconfig.pocketboard
```kconfig
# SPDX-License-Identifier: MIT

config BOARD_POCKETBOARD
    select SOC_NRF52840_QIAA
```

## boards/arm/pocketboard/board.yml
```yaml
board:
  name: pocketboard
  full_name: Pocketboard
  vendor: Datakonsulten
  socs:
    - name: nrf52840
```
